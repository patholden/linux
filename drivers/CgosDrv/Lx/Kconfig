## drivers/CgosDrv/Lx/Kconfig
```kconfig
#
# For a description of the syntax of this configuration file,
# see Documentation/kbuild/kconfig-language.txt.
#
# CGOS configuration.
#

menu "Congatec CGOS API driver"

config CGOS
	bool "Congatec CGOS API driver"
	---help---
	  Sets up platform device for congatec board support.
	  misc_device "cgos" and i2c_adapter "ags-i2c" are also
	  created to support this controller board.
	  
	  If unsure, say Y.

endmenu
```
